#include "oled.h"

#define line(x)	(x*11)

//U8G2_SSD1306_128X64_NONAME_1_HW_I2C u8g2(U8G2_R0, /* reset=*/ U8X8_PIN_NONE);

#define creav_width 74
#define creav_height 25
//#cornerw26h18
static const unsigned char PROGMEM creav[] = {
   0x00, 0x00, 0x00, 0x00, 0x00, 0x00, 0x00, 0x00, 0x00, 0x03, 0x00, 0x00,
   0x00, 0x00, 0x00, 0x00, 0x00, 0x00, 0xf8, 0x00, 0x00, 0x00, 0x00, 0x00,
   0x00, 0x00, 0x00, 0x00, 0xf8, 0x00, 0x00, 0x00, 0x00, 0x00, 0x00, 0x00,
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   0x00, 0x00, 0x00, 0x00, 0x00, 0x00, 0xf0, 0x01, 0x00, 0x00 };

#define batt_width 58
#define batt_height 29
static const unsigned char PROGMEM batt[] = {
   0x00, 0x00, 0xff, 0xff, 0xff, 0x0f, 0x00, 0x00, 0x00, 0x00, 0x01, 0x00,
   0x00, 0x08, 0x00, 0x00, 0x00, 0x00, 0x01, 0x00, 0x80, 0x0b, 0x00, 0x00,
   0x00, 0x60, 0x01, 0x00, 0x80, 0x0b, 0x00, 0x00, 0x00, 0x60, 0x01, 0x00,
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   0x21, 0x2f, 0x09, 0x02 };

oled::oled():u8g2(U8G2_R0, /* reset=*/ U8X8_PIN_NONE) {

}

void oled::drawLogo() {
	u8g2.drawXBMP(26,18, creav_width, creav_height, creav);
}

void oled::drawBattLogo() {
	u8g2.drawXBMP(34,19, batt_width, batt_height, batt);
}

void oled::drawPointer(u8g2_uint_t y) {
	u8g2.setDrawColor(0);
	if(y < 63) {
		y = 63 - y;
		if(y > 59)
			y = 59;
	}
	else 
		y = -2;
    u8g2.drawBox(126,y,2,2);
    u8g2.drawBox(126,y+4,2,2);
    u8g2.setDrawColor(1);
}

void oled::oledInit() {
	u8g2.begin();
	u8g2.enableUTF8Print();
  	u8g2.setFont(u8g2_font_profont11_tf);
  	u8g2.setFontRefHeightText();
  	u8g2.setDrawColor(1);
  	u8g2.setFontPosTop();
  	u8g2.setFontDirection(0);	
}

void oled::drawScreen() {
	u8g2.drawStr(0,line(0),"Temp  :");
  	u8g2.drawStr(0,line(1),"Hum   :");
  	u8g2.drawStr(0,line(2),"Press :");
  	u8g2.drawStr(0,line(3),"PM 1.0:");
  	u8g2.drawStr(0,line(4),"PM 2.5:");
  	u8g2.drawStr(0,line(5),"PM  10:");
  	u8g2.drawStr(101,-1, "300+");
  	u8g2.drawStr(95,56, "AQI:0");
    u8g2.drawBox(126,0,2,63);
}

void oled::setOledReading(float temp, float hum, float press, int pm1, int pm2_5, int pm10) {
	if(temp<0)
		u8g2.setCursor(42,line(0));
	else
		u8g2.setCursor(48,line(0));
	u8g2.print(temp);
	u8g2.print("°C");
	u8g2.setCursor(48,line(1));
	u8g2.print(hum);
	u8g2.print("% RH");
	u8g2.setCursor(48,line(2));
	u8g2.print(press);
	u8g2.print(" hPa");
	u8g2.setCursor(48,line(3));
	u8g2.print(pm1);
	u8g2.setCursor(48,line(4));
	u8g2.print(pm2_5);
	u8g2.setCursor(48,line(5));
	u8g2.print(pm10);
}

void oled::showDebug(float temp, float hum, float press, int pm1, int pm2_5, int pm10, int voltage, int aqi, bool cableInserted) {
	if(temp<0)
		u8g2.setCursor(0,line(0));
	else
		u8g2.setCursor(6,line(0));
	u8g2.print(temp);
	u8g2.print("°C");
	u8g2.setCursor(6,line(1));
	u8g2.print(hum);
	u8g2.print("% RH");
	u8g2.setCursor(6,line(2));
	u8g2.print(press);
	u8g2.print(" hPa");
	u8g2.setCursor(6,line(3));
	u8g2.print(pm1);
	u8g2.setCursor(6,line(4));
	u8g2.print(pm2_5);
	u8g2.setCursor(36,line(4));
	u8g2.print(aqi);
	u8g2.setCursor(6,line(5));
	u8g2.print(pm10);
	u8g2.setCursor(36,line(5));
	u8g2.print(voltage);
	u8g2.print(" V");
	if(cableInserted)
		u8g2.print("+");
}
